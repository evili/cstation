## CMakeLists.txt
```
cmake_minimum_required(VERSION 3.20.0)
find_package(Zephyr REQUIRED HINTS $ENV{ZEPHYR_BASE})
project(cstation)


set(SOURCES
  src/main.cpp
  src/lcc.cpp
  src/lcc_can.cpp
)

set(HEADERS
	include/lcc.hxx
	include/lcc_can.hxx
)

# Expose project include/ to the compiler
target_include_directories(app PRIVATE include)
target_sources(app PRIVATE ${SOURCES} ${HEADERS})
```

## Kconfig
```
menu "OpenLCB CAN options"

config OLCAN_LED_ERROR_ACTIVE_MS
	int "OpenLCB CAN: Error Active blink half-period (ms)"
	default 1000
	range 10 10000
	help
	  Blink half-period in milliseconds for Error Active state. Full period will be 2x this value.

config OLCAN_LED_ERROR_PASSIVE_MS
	int "OpenLCB CAN: Error Passive blink half-period (ms)"
	default 100
	range 10 1000
	help
	  Blink half-period in milliseconds for Error Passive state.

config OLCAN_LED_TX_MS
	int "OpenLCB CAN: TX LED flash duration (ms)"
	default 1
	range 1 1000
	help
	  Duration in milliseconds for the short green TX LED flash (led0).

config OLCAN_LED_RX_MS
	int "OpenLCB CAN: RX LED flash duration (ms)"
	default 1
	range 1 1000
	help
	  Duration in milliseconds for the short blue RX LED flash (led1).

endmenu
```

## prj.conf
```kconfig
CONFIG_CAN=y
CONFIG_GPIO=y
CONFIG_LOG=y
CONFIG_SHELL=y
CONFIG_SPI=n
CONFIG_CPP=y
CONFIG_STDOUT_CONSOLE=y
CONFIG_SYS_HASH_FUNC32=y
CONFIG_SYS_HASH_MAP=y
```

## src/main.c
```c
#include <zephyr/kernel.h>
#include <zephyr/device.h>
#include <zephyr/devicetree.h>
#include <zephyr/drivers/can.h>
#include <zephyr/logging/log.h>
#include <lcc.h>
#include <lcc_can.h>

LOG_MODULE_REGISTER(cstation, LOG_LEVEL_INF);

const lcc_node_id_t CONFIG_LCC_NODE_ID = {0x05, 0x01, 0x01, 0x01, 0x1A, 0x01};
const struct device *can_dev = DEVICE_DT_GET_OR_NULL(DT_NODELABEL(can1));

int main(void) {
    int ret;

    if (!can_dev) {
        LOG_ERR("CAN1 device node not found");
        return -ENODEV;
    }

    if (!device_is_ready(can_dev)) {
        LOG_ERR("CAN1 device not ready");
    } else {
        LOG_INF("CAN1 device ready");
    }

    /* Define LCC node */
    lcc_node_t node;

    ret = lcc_init(&node,
        CONFIG_LCC_NODE_ID,
        (void *) can_dev,
        lcc_can_attach,
        lcc_can_send_message,
        lcc_can_receive_message
    );
    if (ret != 0) {
        LOG_ERR("Failed to initialize LCC node");
        return -EIO;
    }

    while(1) {
        ret = lcc_send_message(&node, &LCC_MESSAGE_VERIFY_NODE_GLOBAL);
        if (ret != 0) {
            LOG_ERR("Failed to send LCC message");
        }
        k_sleep(K_MSEC(1000));
    }

    return 0;
}
```

## src/main.cpp
```c
#include <zephyr/kernel.h>
#include <zephyr/device.h>
#include <zephyr/devicetree.h>
#include <zephyr/drivers/can.h>
#include <zephyr/logging/log.h>
#include <lcc.hxx>
#include <lcc_can.hxx>

LOG_MODULE_REGISTER(cstation, LOG_LEVEL_INF);

lcc_node_id_t CONFIG_LCC_NODE_ID = {0x05, 0x01, 0x01, 0x01, 0x1A, 0x01};
const struct device *can_dev = DEVICE_DT_GET_OR_NULL(DT_NODELABEL(can1));

int main(void) {
    int ret;

    if (!can_dev) {
        LOG_ERR("CAN1 device node not found");
        return -ENODEV;
    }

    if (!device_is_ready(can_dev)) {
        LOG_ERR("CAN1 device not ready");
    } else {
        LOG_INF("CAN1 device ready");
    }

    /* Define LCC node */
    LCC_Node node;
    LCC_Can lcc_can(can_dev);

    ret = node.Init(&CONFIG_LCC_NODE_ID, &lcc_can);
    if (ret != 0) {
        LOG_ERR("Failed to initialize LCC node");
        return -EIO;
    }

    lcc_message_t msg;
    memcpy(&msg, &LCC_MESSAGE_VERIFY_NODE_GLOBAL, sizeof(lcc_message_t));

    while(1) {
        ret = node.Send(&msg);
        if (ret != 0) {
            LOG_ERR("Failed to send LCC message");
        }
        k_sleep(K_MSEC(1000));
    }

    return 0;
}
```

## include/board_leds.h
```c
#ifndef BOARD_LEDS_H
#define BOARD_LEDS_H

#include <zephyr/drivers/gpio.h>

/* Board LED definitions for OpenLCB CAN transport */
#if DT_NODE_HAS_STATUS(DT_ALIAS(led0), okay)
static const struct gpio_dt_spec led0 = GPIO_DT_SPEC_GET(DT_ALIAS(led0), gpios);
#define HAVE_LED0 1
#else
#define HAVE_LED0 0
#endif

#if DT_NODE_HAS_STATUS(DT_ALIAS(led1), okay)
static const struct gpio_dt_spec led1 = GPIO_DT_SPEC_GET(DT_ALIAS(led1), gpios);
#define HAVE_LED1 1
#else
#define HAVE_LED1 0
#endif

#if DT_NODE_HAS_STATUS(DT_ALIAS(led2), okay)
static const struct gpio_dt_spec led2 = GPIO_DT_SPEC_GET(DT_ALIAS(led2), gpios);
#define HAVE_LED2 1
#else
#define HAVE_LED2 0
#endif

#endif /* BOARD_LEDS_H */
```

## include/lcc.h
```c
#ifndef LCC_H
#define LCC_H

#define LCC_NODE_ID_LEN 6

typedef uint8_t lcc_node_id_t[LCC_NODE_ID_LEN];

typedef enum {
    LCC_STATE_UNINITIALIZED = 0,
    LCC_STATE_ATTACHED,
    LCC_STATE_INITIALIZED
} lcc_state_t;

typedef struct lcc_node_t lcc_node_t;

struct lcc_node_t{
    lcc_node_id_t node_id;
    lcc_state_t state;
    void *device;
    int (*attach)  (void *device, lcc_node_t *node);
    int (*send)    (void *device, const struct lcc_message_t *message);
    int (*receive) (void *device, struct lcc_message_t *message);
};

typedef union {
    struct {
        uint8_t reserved  : 2;
        uint8_t special   : 1;
        uint8_t stream    : 1;
        uint8_t priority  : 2;
        uint8_t type      : 5;
        uint8_t simple    : 1;
        uint8_t addressed : 1;
        uint8_t event     : 1;
        uint8_t modifier  : 2;
    }
    uint16_t mti;
} lcc_mti_t;

typedef struct {
    uint16_t mti;
    lcc_node_id_t source;
    size_t len;
    uint8_t *data;
} lcc_message_t;

const lcc_message_t LCC_MESSAGE_VERIFY_NODE_GLOBAL = {
    .mti = 0x0490,
    .data = NULL,
    .len = 0
};

const lcc_message_t LCC_MESSAGE_VERIFY_NODE_ADDRESSED = {
    .mti = 0x0488,
    .data = NULL,
    .len = LCC_NODE_ID_LEN
};

int lcc_node_init(
    lcc_node_t *node,
    const lcc_node_id_t node_id,,
    void *device,
    void *attach,
    void *send,
    void *receive
);

int lcc_send_message(const lcc_node_t *node, const lcc_message_t *message);
int lcc_receive_message(const lcc_node_t *node, lcc_message_t *message);

#endif /* LCC_H */
```

## include/lcc_can.h
```c
#ifndef   LCC_CAN_H
#define   LCC_CAN_H

#include <zephyr/drivers/can.h>
#include "lcc.h"

#define LCC_CAN_CHECK_ID_WAIT 200 // milliseconds

#define LCC_CAN_BIT_RATE 125000 // 125 kbps


typedef union {
    can_frame_id_t can_frame;
    struct {
        uint32_t padding  :  3;
        uint32_t reserved  : 1;
        uint32_t lcc_frame : 1;
        uint32_t content   :15;
        uint32_t source_id :12;
        uint8_t  dlc;
        uint16_t timestamp;
        uint8_t  data[CAN_MAX_DLEN];
    }
} lcc_can_frame_t;


// Filter Masks 
LCC_CAN_FILTER_CONTROL_FRAME_MASK 0x08000000
LCC_CAN_FILTER_CONTENT_FIELD_MASK 0x07FFF000
LCC_CAN_FILTER_SOURCE_ID_MASK     0x00000FFF

LCC_CAN_CONTROL_FRAME 0x00000000
LCC_CAN_LCC_FRAME     0x08000000

const can_filter_t LCC_CAN_CONTROL_FRAME_FILTER = {
    .id    = LCC_CAN_CONTROL_FRAME,
    .mask  = LCC_CAN_FILTER_CONTROL_FRAME_MASK,
    .flags = CAN_FILTER_IDE
};

const can_filter_t LCC_CAN_LCC_FRAME_FILTER = {
    .id    = LCC_CAN_LCC_FRAME,
    .mask  = LCC_CAN_FILTER_CONTROL_FRAME_MASK,
    .flags = CAN_FILTER_IDE
};

typedef enum {
    LCC_CAN_STATE_INHIBITED = 0,
    LCC_CAN_STATE_CHECK_ID1,
    LCC_CAN_STATE_CHECK_ID2,
    LCC_CAN_STATE_CHECK_ID3,
    LCC_CAN_STATE_CHECK_ID4,
    LCC_CAN_STATE_WAIT_ID,
    LCC_CAN_STATE_RESERVE_ID,
    LCC_CAN_STATE_PERMITTED
} lcc_can_state_t;

typedef union {
    uint16_t alias16;
    struct {
        uint16_t pad    : 4;
        uint16_t alias : 12;
    };
} can_alias_id_t;


typedef stuct {
    lcc_can_state_t state;
    const struct device *can_dev;
    const lcc_node_t *node;
    can_alias_id_t alias_id;
} lcc_can_dev_t;


int lcc_can_attach(void *can_device, const lcc_node_t *node);
int lcc_can_send_message(void *can_device, const lcc_message_t *message);
int lcc_can_receive_message(void *can_device, lcc_message_t *message);

void lcc_can_rx_lcc_frame(const lcc_can_dev_t *dev, struct can_frame *frame, void *user_data);
void lcc_can_rx_control_frame(const lcc_can_dev_t *dev, struct can_frame *frame, void *user_data);

#endif // LCC_CAN_H
```

## include/openlcb.h
```c
/**
 * Minimal OpenLCB (LCC) helper over Zephyr CAN
 *
 * This module provides a thin transport abstraction to send/receive CAN frames
 * that are intended to carry OpenLCB payloads.
 *
 * NOTE: This is a minimal, pragmatic helper for testing and integration. It
 * does NOT implement the full OpenLCB specification. Adapt identifiers,
 * extended/standard ID usage and payload formats to match the OpenLCB/CAN
 * mapping required by your network.
 */

#ifndef OPENLCB_H
#define OPENLCB_H

/* Compatibility facade: includes OpenLCB core and CAN transport headers
 * Prefer using openlcb_core.h and openlcb_can.h directly.
 */
#include "openlcb_core.h"
#include "openlcb_can.h"

#ifdef __cplusplus
extern "C" {
#endif

/* Backwards-compatible wrappers */
static inline int openlcb_init(const struct device *can_dev)
{
    return openlcb_can_init_transport(can_dev);
}

static inline void openlcb_register_rx_handler(openlcb_message_cb_t cb, void *user_data)
{
    openlcb_core_register_message_handler(cb, user_data);
}

static inline int openlcb_set_node_id(const uint8_t node_id[6])
{
    openlcb_core_set_node_id(node_id);
    return openlcb_can_set_node_id(node_id);
}

static inline int openlcb_send_hello(void)
{
    /* Start alias negotiation (hello publishes Node ID via AMD when alias reserved) */
    return openlcb_can_start_alias_negotiation();
}

#ifdef __cplusplus
}
#endif

#endif /* OPENLCB_H */
```

## include/openlcb_can.h
```c
/* OpenLCB-CAN transport layer
 * - Implements CAN-specific encoding/decoding per S-9.7.2.1 and TN-9.7.2.1
 * - Manages alias negotiation / state machine (Inhibited / Permitted)
 */
#ifndef OPENLCB_CAN_H
#define OPENLCB_CAN_H

#include <zephyr/drivers/can.h>
#include <zephyr/kernel.h>
#include <zephyr/types.h>

#ifdef __cplusplus
extern "C" {
#endif

typedef enum {
    OLCAN_STATE_INHIBITED = 0,
    OLCAN_STATE_REQUESTING_ALIAS,
    OLCAN_STATE_PERMITTED,
} olcan_state_t;

int openlcb_can_init_transport(const struct device *can_dev);

/* Start alias negotiation (deterministic generator based on Node ID) */
int openlcb_can_start_alias_negotiation(void);

/* Get current alias (0 if none) */
uint16_t openlcb_can_get_alias(void);

/* Set Node ID (6 bytes) */
int openlcb_can_set_node_id(const uint8_t node_id[6]);

/* Send an OpenLCB message (transport will map to CAN frames) */
int openlcb_can_send_message(uint16_t mti, uint16_t dest_alias, const uint8_t *data, size_t len, k_timeout_t timeout);

/* For diagnostics */
olcan_state_t openlcb_can_get_state(void);

/* -------- Test hooks (unit tests) -------- */
typedef int (*openlcb_can_send_hook_t)(const struct can_frame *frame, k_timeout_t timeout);

/* Replace the internal send function with a test hook (captures frames) */
int openlcb_can_set_send_hook(openlcb_can_send_hook_t hook);

/* Initialize transport in test mode (no real device required) */
int openlcb_can_test_init(void);

/* Inject a raw CAN frame (id + data) into the RX path (test helper) */
int openlcb_can_inject_frame(uint32_t id, const uint8_t *data, uint8_t dlc);

/* Inject a simulated CAN controller state change (for unit tests).
 * @param state One of Zephyr's CAN controller states (enum can_state).
 */
int openlcb_can_inject_state_change(int state);

/* Test hook: get current LED indicator mode (0=normal, 1=Error Active, 2=Error Passive, 3=Bus Off) */
int openlcb_can_get_led_mode(void);

/* Test helper: get current blink half-period in ms (0 when not blinking) */
int openlcb_can_get_blink_ms(void);

/* Test helper: get LED0 (green) busy state (1 when flashing) */
int openlcb_can_get_led0_busy(void);

/* Test helper: get LED1 (blue) busy state (1 when flashing) */
int openlcb_can_get_led1_busy(void);

/* Test helper: get configured LED1 flash duration in ms */
int openlcb_can_get_led1_flash_ms(void);

/* Test helper: get configured LED0 flash duration in ms */
int openlcb_can_get_led0_flash_ms(void);

#ifdef __cplusplus
}
#endif

#endif /* OPENLCB_CAN_H */
```

## include/openlcb_core.h
```c
/* Minimal OpenLCB core layer (transport-agnostic)
 * - Represents Node ID
 * - Provides simple message send/receive API for upper layers
 * - Delegates transport to an OpenLCB-CAN transport implementation
 */
#ifndef OPENLCB_CORE_H
#define OPENLCB_CORE_H

#include <zephyr/kernel.h>
#include <zephyr/types.h>

#ifdef __cplusplus
extern "C" {
#endif

/* 6-byte Node ID */
int openlcb_core_set_node_id(const uint8_t node_id[6]);
const uint8_t *openlcb_core_get_node_id(void);

/* Message callback signature (transport-agnostic). Called from worker context. */
typedef void (*openlcb_message_cb_t)(const uint8_t *data, size_t len, void *user_data);
void openlcb_core_register_message_handler(openlcb_message_cb_t cb, void *user_data);

/* Called by transport when a complete OpenLCB message is received (worker context) */
void openlcb_core_incoming_message(const uint8_t *data, size_t len);

#ifdef __cplusplus
}
#endif

#endif /* OPENLCB_CORE_H */
```

## src/lcc.c
```c
_#include <lcc.h>
#include <errno.h>

int lcc_init(
    const lcc_node_t *node,
    const uint8_t *node_id,
    void *device,
    void *attach,
    void *send,
    void *receive
) {
    if (!node || !node_id || !device || !attach || !send || !receive) {
        LOG_ERR("lcc_init: invalid arguments");
        return -EINVAL;
    }

    memcpy(node_id, node->node_id, LCC_NODE_ID_SIZE);
    node->device = *device;
    node->attach =   (int (*)(void *, lcc_node_t *)) attach;
    node->send =     (int (*)(void *, const lcc_message_t *)) send;
    node->receive =  (int (*)(void *, lcc_message_t *)) receive;

    node->state = LCC_STATE_ATTACHED;

    int ret = node->attach(device, node);
    if (ret < 0) {
        LOG_ERR("lcc_init: failed to attach device");
        return ret;
    }
    node->state = LCC_STATE_INITIALIZED;
    return 0;
}

int lcc_send_message(const lcc_node_t *node, const lcc_message_t *message) {
    if (!node || !message || !message->data || message->len == 0) {
        LOG_ERR("lcc_send_message: invalid arguments");
        return -EINVAL;
    }
    if (node->state != LCC_STATE_INITIALIZED) {
        LOG_ERR("lcc_send_message: node not initialized");
        return -EACCES;
    }
    return node->send(node->device , message);
}

int lcc_receive_message(lcc_node_t *node, lcc_message_t *message) {
    if (!node || !message) {
        LOG_ERR("lcc_receive_message: invalid arguments");
        return -EINVAL;
    }
    if (node->state != LCC_STATE_INITIALIZED) {
        LOG_ERR("lcc_receive_message: node not initialized");
        return -EACCES;
    }
    return node->receive(node->device , message);
}
```

## src/lcc.cpp
```c
#include <zephyr/logging/log.h>
#include <errno.h>

#include <lcc.hxx>


LOG_MODULE_REGISTER(lcc, LOG_LEVEL_INF);

int LCC_Node::Init(lcc_node_id_t *node_id, LCC_Device *device) {
	if (!node_id || !device) {
        LOG_ERR("lcc_init: invalid arguments");
        return -EINVAL;
    }

    memcpy(node_id, this->id, LCC_NODE_ID_LEN);
    this->device = device;

    state = LCC_STATE_ATTACHED;

    int ret = this->device->attach(this);
    if (ret < 0) {
        LOG_ERR("lcc_init: failed to attach device");
        return ret;
    }
    state = LCC_STATE_INITIALIZED;
    return 0;
}

int LCC_Node::Send(lcc_message_t *message) {
    if (!message || !message->data || message->len == 0) {
        LOG_ERR("lcc_send_message: invalid arguments");
        return -EINVAL;
    }
    if (state != LCC_STATE_INITIALIZED) {
        LOG_ERR("lcc_send_message: node not initialized");
        return -EACCES;
    }
    memcpy(message->source, this->id, LCC_NODE_ID_LEN);
    return device->send(message);
}

int LCC_Node::Receive(lcc_message_t *message) {
    if (!message) {
        LOG_ERR("lcc_receive_message: invalid arguments");
        return -EINVAL;
    }
    if (state != LCC_STATE_INITIALIZED) {
        LOG_ERR("lcc_receive_message: node not initialized");
        return -EACCES;
    }
    return device->recv(message);
}
```

## src/lcc_can.c
```c
#include <lcc_can.h>
#include <zephyr/logging/log.h>
#include <zephyr/drivers/can.h>
#include <zephyr/sys/hash_map.h>
#include <zephyr/device.h>

SYS_HASH_MAP_DEFINE_STATIC(can_alias_map);


int lcc_can_attach(void *can_device, const lcc_node_t *node) {
    int ret;
    if (!can_device || !node) {
        LOG_ERR("lcc_can_attach: invalid arguments");
        return -EINVAL;
    }
    lcc_can_dev_t *lcc_can = (lcc_can_dev_t *) can_device;

    if(!lcc_can->can_dev || !device_is_ready(lcc_can->can_dev)) { {
        LOG_ERR("lcc_can_attach: CAN device not ready");
        return -EINVAL;
    }
    lcc_can->state = LCC_CAN_STATE_INHIBITED;
    device *can_dev = lcc_can->can_dev;

    lcc_can->node = node;

    if(can_stop(can_dev) == -EIO) {
        LOG_ERR("lcc_can_attach: failed to stop CAN device");
        return -EIO;
    }

    struct can_timing timing;
    ret = can_set_bitrate(can_dev, LCC_CAN_BITRATE);
    if (ret != 0) {
        LOG_ERR("lcc_can_attach: failed to set CAN bitrate");
        return ret;
    }

    can_add_rx_filter(can_dev, lcc_can_rx_control_frame, (void *) node, LCC_CAN_CONTROL_FRAME_FILTER);
    can_add_rx_filter(can_dev, lcc_can_rx_lcc_frame, (void *) node, LCC_CAN_LCC_FRAME_FILTER);

    if(can_start(can_dev) == -EIO) {
        LOG_ERR("lcc_can_attach: failed to start CAN device");
        return -EIO;
    }
    ret = lcc_can_enter_permitted_state(lcc_can);
    return ESUCCESS;
}

int lcc_can_enter_permitted_state(lcc_can_dev_t *lcc_can) {
    int ret;
    if (!lcc_can || !lcc_can->node || !lcc_can->can_dev) {
        LOG_ERR("lcc_can_enter_permitted_state: invalid argument");
        return -EINVAL;
    }
    if (lcc_can->state >= LCC_CAN_STATE_PERMITTED) {
        LOG_WRN("lcc_can_enter_permitted_state: already in PERMITTED state");
        return ESUCCESS;
    }

    while (lcc_can->state != LCC_CAN_STATE_PERMITTED) {
        lcc_can_get_next_alias(lcc_can);
        ret = lcc_send_check_id(lcc_can);
        if(ret < 0) {
            LOG_ERR("lcc_can_enter_permitted_state: failed to send CHECK_ID message");
            lcc_can->state = LCC_CAN_STATE_INHIBITED;
            continue;
        }
        k_sleep(K_MSEC(LCC_CAN_CHECK_ID_WAIT));
        ret = lcc_send_reserve_id(lcc_can);
        if(ret < 0) {
            LOG_ERR("lcc_can_enter_permitted_state: failed to send RESERVE_ID message");
            lcc_can->state = LCC_CAN_STATE_INHIBITED;
            continue;
        }  
    }
    lcc_can->state = LCC_CAN_STATE_PERMITTED;
    uint64_t node_id = (uint64_t *) lcc_can->node->node_id;
    sys_hashmap_insert(lcc_can->alias_map, lcc_can->alias, node_id, NULL);
    LOG_INF("Node [0x%064x] entered PERMITTED state with alias %d", node_id, lcc_can->alias);
    return ESUCCESS;
}

void lcc_can_rx_control_frame(const struct device *dev, struct can_frame *frame, void *user_data) {
    if (!dev || !frame || !user_data) {
        LOG_ERR("lcc_can_rx_control_frame: invalid arguments");
        return;
    }
    lcc_node_t *node = (lcc_node_t *) user_data;
    lcc_can_frame_t *lcc_frame = (lcc_can_frame_t *) frame;
    LOG_DBG("Received control frame from [0x%012x]: type=0x%01x, content=0x%015x, dlc=%d",
         lcc_frame->source_id,
         lcc_frame->lcc_frame,
         lcc_frame->content,
         lcc_frame->dlc);
}

int lcc_can_rx_lcc_frame(const struct device *dev, struct can_frame *frame, void *user_data) {
    if (!dev || !frame || !user_data) {
        LOG_ERR("lcc_can_rx_lcc_frame: invalid arguments");
        return -EINVAL;
    }
    lcc_node_t *node = (lcc_node_t *) user_data;
    lcc_can_frame_t *lcc_frame = (lcc_can_frame_t *) frame;
    if (lcc_frame->lcc_frame != 1) {
        LOG_WRN("Received non-LCC frame in LCC filter");
        return -EINVAL;
    }
    LOG_DBG("Received LCC frame from [0x%012x]: type=0x%01x, content=0x%015x, dlc=%d",
         lcc_frame->source_id,
         lcc_frame->lcc_frame,
         lcc_frame->content,
         lcc_frame->dlc
    );
    // TODO: implement receiving LCC as part of many CAN Frames.
    LOG_ERR("LCC Receiving not implemented yet");
    free(lcc_message);
    free(data);
    return -ENOTSUP;
/*
    lcc_message_t *lcc_message = malloc(sizeof(lcc_message_t));
    uint8_t *data = malloc(lcc_frame->dlc);

    if (!lcc_message || !data) {
        LOG_ERR("Failed to allocate memory for LCC message");
        free(lcc_message);
        free(data);
        return -ENOMEM;
    }
*/
}   
```

## src/lcc_can.cpp
```c
#include <lcc_can.hxx>
#include <zephyr/logging/log.h>
#include <zephyr/drivers/can.h>
#include <zephyr/sys/hash_map.h>
#include <zephyr/device.h>
#include <errno.h>

LOG_MODULE_REGISTER(lcc_can, LOG_LEVEL_INF);

SYS_HASHMAP_DEFAULT_DEFINE(LCC_CAN_Alias_Map);

LCC_Can::LCC_Can(const device *dev) {
  if(!dev) {
    LOG_ERR("lcc_can_attach: invalid arguments");
  }
  can_dev = dev;
}

int LCC_Can::attach(LCC_Node *node) {
    int ret;
    if (!node) {
        LOG_ERR("lcc_can_attach: invalid arguments");
        return -EINVAL;
    }
    
    if(!can_dev || !device_is_ready(can_dev)) {
        LOG_ERR("lcc_can_attach: CAN device not ready");
        return -EINVAL;
    }
    state = LCC_CAN_STATE_INHIBITED;

    this->node = node;

    if(can_stop(can_dev) == -EIO) {
        LOG_ERR("lcc_can_attach: failed to stop CAN device");
        return -EIO;
    }

    ret = can_set_bitrate(can_dev, LCC_CAN_BIT_RATE);
    if (ret != 0) {
        LOG_ERR("lcc_can_attach: failed to set CAN bitrate");
        return ret;
    }

    // can_add_rx_filter(can_dev, lcc_can_rx_control_frame, (void *) node, LCC_CAN_CONTROL_FRAME_FILTER);
    // can_add_rx_filter(can_dev, lcc_can_rx_lcc_frame, (void *) node, LCC_CAN_LCC_FRAME_FILTER);

    if(can_start(can_dev) == -EIO) {
        LOG_ERR("lcc_can_attach: failed to start CAN device");
        return -EIO;
    }
    return lcc_enter_permitted_state();
}

int LCC_Can::lcc_enter_permitted_state() {
    int ret;
    if (!node || !can_dev) {
        LOG_ERR("lcc_can_enter_permitted_state: invalid argument");
        return -EINVAL;
    }
    if (state >= LCC_CAN_STATE_PERMITTED) {
        LOG_WRN("lcc_can_enter_permitted_state: already in PERMITTED state");
        return 0;
    }

    while (state != LCC_CAN_STATE_PERMITTED) {
        lcc_can_get_next_alias();
        ret = lcc_send_check_id();
        if(ret < 0) {
            LOG_ERR("lcc_can_enter_permitted_state: failed to send CHECK_ID message");
            state = LCC_CAN_STATE_INHIBITED;
            continue;
        }
        k_sleep(K_MSEC(LCC_CAN_CHECK_ID_WAIT));
        ret = lcc_send_reserve_id();
        if(ret < 0) {
            LOG_ERR("lcc_can_enter_permitted_state: failed to send RESERVE_ID message");
            state = LCC_CAN_STATE_INHIBITED;
            continue;
        }  
    }
    state = LCC_CAN_STATE_PERMITTED;

    uint64_t *node_id = (uint64_t *) node->get_id();

    // TODO: sys_hashmap_insert(alias_map, alias.alias16, node_id, NULL);
    LOG_INF("Node [0x%064llx] entered PERMITTED state with alias %x", *node_id, alias.alias);
    return 0;
}

int LCC_Can::lcc_can_rx_control_frame(struct can_frame *frame) {
    if (!frame) {
        LOG_ERR("lcc_can_rx_control_frame: invalid arguments");
        return -EINVAL;
    }
    lcc_can_frame_t *lcc_frame = (lcc_can_frame_t *) frame;
    LOG_DBG("Received control frame from [0x%012x]: type=0x%01x, content=0x%015x, dlc=%d",
         lcc_frame->source_id,
         lcc_frame->lcc_frame,
         lcc_frame->content,
         lcc_frame->dlc);

    LOG_ERR("LCC Receiving Control Frame not implemented yet");
    return -ENOTSUP;

}

int LCC_Can::lcc_can_rx_lcc_frame(struct can_frame *frame) {
    if (!frame) {
        LOG_ERR("lcc_can_rx_lcc_frame: invalid arguments");
        return -EINVAL;
    }
    lcc_can_frame_t *lcc_frame = (lcc_can_frame_t *) frame;
    if (lcc_frame->lcc_frame != 1) {
        LOG_WRN("Received non-LCC frame in LCC filter");
        return -EINVAL;
    }
    LOG_DBG("Received LCC frame from [0x%012x]: type=0x%01x, content=0x%015x, dlc=%d",
         lcc_frame->source_id,
         lcc_frame->lcc_frame,
         lcc_frame->content,
         lcc_frame->dlc
    );
    // TODO: implement receiving LCC as part of many CAN Frames.
    LOG_ERR("LCC Receiving LCC Frame not implemented yet");
    // free(lcc_message);
    return -ENOTSUP;
/*
    lcc_message_t *lcc_message = malloc(sizeof(lcc_message_t));
    uint8_t *data = malloc(lcc_frame->dlc);

    if (!lcc_message || !data) {
        LOG_ERR("Failed to allocate memory for LCC message");
        free(lcc_message);
        free(data);
        return -ENOMEM;
    }
*/
}   
```
